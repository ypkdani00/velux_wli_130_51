// ===========================================================================
//  VELUX WLI 130 51  -  ESP32-C6 IR remote control, Zigbee + Wi-Fi
// ===========================================================================
//  The WLI 130 51 is the VELUX wall keypad with a built-in IR receiver
//  (WLC 100 control unit). It is normally operated with the WLR 100 remote.
//  This firmware generates the same commands, checksum included - see
//  VeluxIR.h for the protocol details.
//
//  Each keypad is identified, over IR, ONLY by its security code (the 10
//  internal DIP switches). The 0-F rotary address selector is NOT part of the
//  IR frame: it is only used on the wire towards the WLC 100. So a single
//  board can drive several keypads, as long as they are all in view of the IR
//  LED: each one only reacts to frames carrying its own code.
//
//  Board: DFRobot FireBeetle 2 ESP32-C6
//    GPIO22 -> Gravity IR transmitter module (DFR0095)
//    GPIO21 -> Gravity self-locking switch (DFR0423): ON = Wi-Fi on
//    GPIO0  -> battery voltage (the board's own 1:2 divider)
//    GPIO15 -> onboard LED: steady = booting, flash every 1 s = Zigbee pairing,
//              every 5 s = joined and waiting
//    GPIO9  -> BOOT button: hold 3s to leave the Zigbee network
//  Zigbee runs all the time (window coverings for Home Assistant); Wi-Fi
//  (web UI, HTTP API, OTA) only while the switch is ON. See Config.h §7.
//
//  Build with PlatformIO (platformio.ini): it sets up Zigbee end-device mode,
//  the partition table and light sleep. export_release.ps1 does it in one step.
//
//  ---------------------------------------------------------------------
//  ADAPTING THIS FIRMWARE TO A DIFFERENT INSTALLATION
//  Everything you are likely to need to change lives in Config.h: the
//  security code of each keypad, the Wi-Fi credentials, the pins, the
//  safety delay, the power-saving options and Zigbee. This file should not
//  need any editing.
//  ---------------------------------------------------------------------
// ===========================================================================

#include <Arduino.h>
#include <WiFi.h>
#include <WebServer.h>
#include <ESPmDNS.h>
#include <ArduinoOTA.h>
#include <Preferences.h>

#include <esp32-hal-rmt.h> // IR frames generated by the RMT peripheral, see sendFrame()
#include <esp_system.h>   // esp_reset_reason(), for the boot diagnostics below
#include <esp_wifi.h>     // esp_wifi_set_bandwidth(), for kWifiNarrowBandwidth
#include <esp_sntp.h>     // NTP reply callback, see clockFromNtp
#include <esp_pm.h>      // automatic light sleep / DFS, for kEnablePowerManagement
#include <lwip/sockets.h> // select() on the server sockets, see waitForWork()
#include <Update.h>       // in-place firmware flashing from an uploaded .bin

#include "Config.h"

// platformio.ini's firebeetle2_c6 environment sets all three.
#if !CONFIG_IDF_TARGET_ESP32C6 || !defined(ZIGBEE_MODE_ED) || !CONFIG_ZB_ENABLED
#error "Build for the FireBeetle 2 ESP32-C6 with PlatformIO: pio run -e firebeetle2_c6 (Zigbee end device)"
#endif
#include "Zigbee.h"
extern "C" {
#include "zboss_api.h"   // zb_zdo_pim_*: poll interval of a sleepy end device
}
#include <utility>

#include "VeluxIR.h"
#include "WebUI.h"      // the page source (kIndexHtml) - edit this one
#include "WebUI_gz.h"   // the same page gzipped, generated by tools/build_webui_gz.js

// FNV-1a over the page source, evaluated by the compiler ('\r' skipped so a
// CRLF checkout hashes the same). If WebUI.h was edited without regenerating
// WebUI_gz.h, the build stops here instead of serving the old page.
constexpr uint32_t webUiHash(const char* s, size_t n) {
  uint32_t h = 2166136261u;
  for (size_t i = 0; i < n; ++i) {
    if (s[i] == '\r') continue;
    h ^= (uint8_t)s[i];
    h *= 16777619u;
  }
  return h;
}
static_assert(webUiHash(kIndexHtml, sizeof(kIndexHtml) - 1) == kIndexHtmlGzSourceHash,
              "WebUI.h changed: run  node tools/build_webui_gz.js  to regenerate WebUI_gz.h");

static const uint8_t kMotors[4] = {velux::kMotorWindow, velux::kMotorBlind,
                                   velux::kMotorAwning, velux::kMotorAll};

// WARNING: this order MUST match the web UI columns (GLYPH array and
// headings in WebUI.h). A mismatch silently sends the wrong command - it has
// happened before.
//
//        column 0      column 1    column 2
//        open          stop        close
static const uint8_t kActions[3] = {velux::ACT_OPEN_AUTO, velux::ACT_STOP,
                                    velux::ACT_CLOSE_AUTO};

static const uint16_t kHttpPort = 80;
static const uint16_t kOtaPort  = 3232;   // ArduinoOTA's usual port
WebServer server(kHttpPort);
Preferences prefs;

static uint16_t panelCode[kPanelCount];    // security code, already parsed
static String   logLines[kLogEntries];
static String   logTimes[kLogEntries];   // when each line was written, see clockStamp()
static uint8_t  logCount = 0;

// Joined to the home network / running the setup access point. Briefly both
// while the board reconnects after an outage (see handleWifiWatchdog()).
static bool     staConnected = false;
static bool     apActive     = false;
static String   configuredSsid;
static String   configuredPass;

// Anti-reversal cooldown bookkeeping: last non-stop action and its timestamp,
// per panel/motor combination. kMotors has 4 entries (3 motors + "all"), so 4
// slots per panel are enough: commands on a single motor and on "all" are
// tracked separately.
// Zigbee commands are executed by their own task (zbCmdTask) at a higher
// priority than loop() and the web server, so neither makes a command wait.
// The IR channel, the anti-jam bookkeeping and the log are shared with the
// HTTP handlers that run in loop(), hence the locks:
static SemaphoreHandle_t cmdLock = nullptr;   // recursive: one command / frame at a time
static SemaphoreHandle_t logLock = nullptr;   // the frame log
static TaskHandle_t      loopTask = nullptr;  // loop(): woken up by a task notification
struct CmdGuard {
  CmdGuard()  { if (cmdLock) xSemaphoreTakeRecursive(cmdLock, portMAX_DELAY); }
  ~CmdGuard() { if (cmdLock) xSemaphoreGiveRecursive(cmdLock); }
};
struct LogGuard {
  LogGuard()  { if (logLock) xSemaphoreTake(logLock, portMAX_DELAY); }
  ~LogGuard() { if (logLock) xSemaphoreGive(logLock); }
};

// STOP has priority over everything: a STOP that arrives from the Zigbee
// network goes first in the queue, drops the commands it covers that are
// still waiting, cuts short the pause of a command in progress and skips the
// short wait after a frame (see zbEnqueue(), runCommand(), sendFrame()).
static volatile int16_t stopPendingCover = -1;   // cover (panel*4 + motor, motor 3 = all) of a STOP not sent yet, or -1

// Does a STOP for cover stopCover cover a command for panel p, motor m (3 = all)?
static bool stopCovers(int stopCover, int p, int m) {
  if (stopCover < 0) return false;
  const int sp = stopCover / 4, sm = stopCover % 4;
  return sp == p && (sm == 3 || m == 3 || sm == m);
}

static int8_t   lastDirAction[kPanelCount][4];   // -1 = none / cleared by a STOP
static uint32_t lastDirTime[kPanelCount][4];

// Defined further down but used earlier.
static const char* resetReasonName(esp_reset_reason_t r);
static const char* zigbeeStatus();
static bool usbLogSaved();
static bool zbPairedFlag();     // the network was joined once (stored in NVS)
static bool zigbeePairing();    // stack running, not (yet) on a network
static bool zbRequestPair();    // web UI: start the stack / the search for a network
static void zbRequestForget();  // web UI: leave the network, back to "not paired"

// ------------------------------ power management ----------------------------
//
// See kEnablePowerManagement in Config.h.
static String   pmStatus     = "off";
static bool     usbLog       = true;   // USB console on this boot, see "USB log" in the web UI
// Mode of this boot, from the mode switch: Wi-Fi on (web UI, HTTP API, OTA)
// or Zigbee only. Read first thing in setup(): it sets the CPU clock.
static bool     wifiEnabled  = true;
static esp_pm_lock_handle_t pmBusyLock = nullptr;   // nullptr = no PM running

// Holds the CPU at full clock and out of light sleep for as long as it
// exists. Used around IR transmission (a nap between the two copies of a
// frame would stretch the gap) and ADC readings. A no-op when PM isn't
// running.
struct PmBusy {
  PmBusy()  { if (pmBusyLock) esp_pm_lock_acquire(pmBusyLock); }
  ~PmBusy() { if (pmBusyLock) esp_pm_lock_release(pmBusyLock); }
};

static void setupPowerManagement() {
  if (!kEnablePowerManagement) {
    pmStatus = "off (kEnablePowerManagement = false)";
    return;
  }
  if (usbLog) {   // light sleep switches the chip's USB port off
    pmStatus = "off (USB log on)";
    return;
  }
  // Wi-Fi on: fixed at the maximum. Zigbee only: floats from the lowest clock
  // (the crystal, 40MHz) at rest up to kCpuFreqMhz while there is work -
  // a Zigbee packet, an IR frame (PmBusy) - and goes back down by itself.
  esp_pm_config_t cfg = {};
  cfg.max_freq_mhz = wifiEnabled ? kCpuFreqWifiMhz : kCpuFreqMhz;
  cfg.min_freq_mhz = wifiEnabled ? kCpuFreqWifiMhz : kCpuFreqIdleMinMhz;
  cfg.light_sleep_enable = true;
  const String range = (cfg.min_freq_mhz == cfg.max_freq_mhz)
                           ? String(cfg.max_freq_mhz) + " MHz"
                           : String(cfg.min_freq_mhz) + "-" + cfg.max_freq_mhz + " MHz";
  esp_err_t err = esp_pm_configure(&cfg);
  if (err == ESP_OK) {
    pmStatus = String("light sleep + DFS ") + range;
  } else if (err == ESP_ERR_NOT_SUPPORTED) {
    // Either no PM at all in this build, or PM without tickless idle (no
    // light sleep). Frequency scaling alone is still worth having.
    cfg.light_sleep_enable = false;
    err = esp_pm_configure(&cfg);
    if (err == ESP_OK) pmStatus = String("DFS only ") + range + " (no tickless idle in this core build)";
  }
  if (err != ESP_OK) {
    pmStatus = (err == ESP_ERR_NOT_SUPPORTED)
                   ? "not in this core build (CONFIG_PM_ENABLE off)"
                   : String("esp_pm_configure failed: ") + esp_err_to_name(err);
    return;
  }
  esp_pm_lock_create(ESP_PM_CPU_FREQ_MAX, 0, "velux", &pmBusyLock);
}

// Firmware uploads (web UI or OTA) move a megabyte
// through a radio that normally naps between beacons: keep everything awake
// for the duration, or the transfer crawls and can time out. Released again
// only if the update fails - on success the board reboots anyway.
static bool pmUpdateHold = false;
static void holdAwakeForUpdate(bool hold) {
  if (hold == pmUpdateHold) return;
  pmUpdateHold = hold;
  WiFi.setSleep(hold ? WIFI_PS_NONE : kWifiPowerSave);
  if (pmBusyLock) {
    if (hold) esp_pm_lock_acquire(pmBusyLock);
    else      esp_pm_lock_release(pmBusyLock);
  }
}

static String wifiPsName(wifi_ps_type_t ps) {
  switch (ps) {
    case WIFI_PS_NONE:      return "off (radio always on)";
    case WIFI_PS_MIN_MODEM: return "min modem (wakes every DTIM)";
    case WIFI_PS_MAX_MODEM: return String("max modem (wakes every ~") + (kWifiListenInterval * 1024UL / 10) + " ms)";
    default:                return "unknown";
  }
}

// ------------------------------ idle wait -----------------------------------
//
// loop() used to spin (WebServer only yields 1ms per pass), which keeps the
// CPU busy and light sleep out of reach. Instead it now blocks in select()
// on the sockets that can bring work - a new HTTP connection, data on the
// one being served, an ArduinoOTA invitation - with a timeout for the
// periodic jobs. A task blocked there costs nothing, and a request is picked
// up the moment it arrives, not at the next poll.
//
// WebServer and ArduinoOTA keep their sockets private, so findSocket() looks
// them up in lwIP right after they start (when they're the only sockets on
// their ports). If that ever fails, waitForWork() degrades to a timed pause
// and everything still works, just with up to kLoopMaxWaitMs extra latency.
static const uint32_t kLoopMaxWaitMs = 1000;   // periodic jobs: watchdog 5s, battery 60s
static int httpListenFd = -1;
static int otaFd        = -1;

static int findSocket(int type, uint16_t port) {
  for (int fd = LWIP_SOCKET_OFFSET; fd < LWIP_SOCKET_OFFSET + CONFIG_LWIP_MAX_SOCKETS; ++fd) {
    int t = 0;
    socklen_t len = sizeof(t);
    if (getsockopt(fd, SOL_SOCKET, SO_TYPE, &t, &len) != 0 || t != type) continue;
    if (type == SOCK_STREAM) {          // the listener, not an accepted connection
      int listening = 0;
      len = sizeof(listening);
      if (getsockopt(fd, SOL_SOCKET, SO_ACCEPTCONN, &listening, &len) != 0 || !listening) continue;
    }
    struct sockaddr_storage a;
    len = sizeof(a);
    if (getsockname(fd, (struct sockaddr*)&a, &len) != 0) continue;
    uint16_t p = 0;
    if (a.ss_family == AF_INET) p = ntohs(((struct sockaddr_in*)&a)->sin_port);
#if LWIP_IPV6
    else if (a.ss_family == AF_INET6) p = ntohs(((struct sockaddr_in6*)&a)->sin6_port);
#endif
    if (p == port) return fd;
  }
  return -1;
}

// ------------------------------ helpers -------------------------------------

static String hex24(uint32_t f) {
  char buf[12];
  snprintf(buf, sizeof(buf), "0x%06X", (unsigned)(f & 0xFFFFFF));
  return String(buf);
}

static String bin(uint32_t v, uint8_t n) {
  String s;
  for (int8_t i = n - 1; i >= 0; --i) s += ((v >> i) & 1) ? '1' : '0';
  return s;
}

// "2d 4h 13m", "4h 13m", "13m 05s" or "42s" - whichever units are relevant.
// Note: wraps every ~49.7 days along with millis() itself; harmless here,
// the board reboots far more often than that in practice.
static String formatUptime(uint32_t seconds) {
  const uint32_t d = seconds / 86400;
  const uint32_t h = (seconds % 86400) / 3600;
  const uint32_t m = (seconds % 3600) / 60;
  const uint32_t s = seconds % 60;
  String out;
  if (d) { out += d; out += "d "; out += h; out += "h "; out += m; out += "m"; }
  else if (h) { out += h; out += "h "; out += m; out += "m"; }
  else if (m) { out += m; out += "m "; if (s < 10) out += '0'; out += s; out += "s"; }
  else { out += s; out += "s"; }
  return out;
}

// ------------------------------ clock ---------------------------------------
//
// The chip has no battery-backed calendar clock: its RTC timer only counts,
// through light sleep, until power is lost. The date comes from NTP (Wi-Fi
// mode, kNtpServer) and is stored in flash - on every restart and hourly -
// so that Zigbee-only mode, which has no internet, still knows the time
// after the switch is flipped. Without NTP since the last boot the clock is
// the stored value plus the time counted since: marked "~" (it drifts a
// little in sleep and loses the seconds of every restart).
static bool clockFromNtp  = false;   // an NTP reply has set the clock since boot
static bool clockSaveDue  = false;

static bool clockSet() { return time(nullptr) > 1700000000; }

// "03/10 13:04:39" in kTimezone; "~03/10 13:04:39" if not confirmed by NTP
// since boot; "up 1m 10s" while no clock is known at all.
static String clockStamp() {
  if (!clockSet()) return String("up ") + formatUptime(millis() / 1000);
  const time_t n = time(nullptr);
  struct tm t;
  localtime_r(&n, &t);
  char b[24];
  strftime(b, sizeof b, "%d/%m %H:%M:%S", &t);
  return String(clockFromNtp ? "" : "~") + b;
}

static void saveClock() {
  if (!clockSet()) return;
  prefs.begin("velux", false);
  prefs.putUInt("clock", (uint32_t)time(nullptr));
  prefs.end();
}

static void restoreClock() {
  if (clockSet()) return;
  prefs.begin("velux", true);
  const uint32_t saved = prefs.getUInt("clock", 0);
  prefs.end();
  if (saved > 1700000000) {
    const timeval tv = {(time_t)saved, 0};
    settimeofday(&tv, nullptr);
  }
}

static void handleClockSave() {
  static uint32_t last = 0;
  const uint32_t now = millis();
  if (!clockSaveDue && (uint32_t)(now - last) < 3600000UL) return;
  clockSaveDue = false;
  last = now;
  saveClock();
}

// Every restart goes through here so the clock survives it.
static void restartBoard() {
  saveClock();
  ESP.restart();
}

// Escapes a string for safe embedding inside a JSON string literal. Needed
// for anything that isn't a value we chose ourselves (like an SSID picked up
// from a network scan or entered by hand), since it can contain quotes,
// backslashes or other networks' operators' creative characters.
static String jsonEscape(const String& s) {
  String out;
  out.reserve(s.length() + 8);
  for (size_t i = 0; i < s.length(); ++i) {
    const char c = s[i];
    switch (c) {
      case '"':  out += "\\\""; break;
      case '\\': out += "\\\\"; break;
      case '\n': out += "\\n";  break;
      case '\r': out += "\\r";  break;
      case '\t': out += "\\t";  break;
      default:
        if ((uint8_t)c >= 0x20) out += c;   // drop other control characters
    }
  }
  return out;
}

// Reads the string value of "key" from a flat JSON object such as the ones
// the web UI posts ({"ssid":"...","pass":"..."}), undoing JSON escapes: a
// password with a quote or a backslash in it arrives as \" or \\ and has to
// be stored as the character itself, or the board can never join that
// network. \uXXXX is decoded to UTF-8 (browsers only use it for control
// characters; everything else, accents included, arrives as raw UTF-8).
// Returns false if the key is missing or its value isn't a proper string.
static bool jsonStringField(const String& body, const char* key, String& out) {
  const String needle = String('"') + key + '"';
  int i = body.indexOf(needle);
  if (i < 0) return false;
  i += needle.length();
  const int n = body.length();
  while (i < n && isspace((unsigned char)body[i])) ++i;
  if (i >= n || body[i++] != ':') return false;
  while (i < n && isspace((unsigned char)body[i])) ++i;
  if (i >= n || body[i++] != '"') return false;

  out = "";
  while (i < n) {
    const char c = body[i++];
    if (c == '"') return true;
    if (c != '\\') { out += c; continue; }
    if (i >= n) return false;
    const char e = body[i++];
    switch (e) {
      case '"': case '\\': case '/': out += e; break;
      case 'b': out += '\b'; break;
      case 'f': out += '\f'; break;
      case 'n': out += '\n'; break;
      case 'r': out += '\r'; break;
      case 't': out += '\t'; break;
      case 'u': {
        if (i + 4 > n) return false;
        uint32_t cp = 0;
        for (uint8_t k = 0; k < 4; ++k) {
          const char h = body[i++];
          if (!isxdigit((unsigned char)h)) return false;
          cp = (cp << 4) | (uint32_t)(isdigit((unsigned char)h) ? h - '0' : (tolower(h) - 'a' + 10));
        }
        if (cp == 0) return false;
        if (cp < 0x80) {
          out += (char)cp;
        } else if (cp < 0x800) {
          out += (char)(0xC0 | (cp >> 6));
          out += (char)(0x80 | (cp & 0x3F));
        } else {
          out += (char)(0xE0 | (cp >> 12));
          out += (char)(0x80 | ((cp >> 6) & 0x3F));
          out += (char)(0x80 | (cp & 0x3F));
        }
        break;
      }
      default: return false;
    }
  }
  return false;   // unterminated string
}

// Parses "1011100000" into 10 bits. Returns 0xFFFF if the string is invalid.
static uint16_t parseSecurity(const char* s) {
  if (!s) return 0xFFFF;
  uint16_t code = 0;
  uint8_t n = 0;
  for (const char* p = s; *p; ++p, ++n) {
    if (n >= 10 || (*p != '0' && *p != '1')) return 0xFFFF;
    code = (code << 1) | (uint16_t)(*p - '0');
  }
  return n == 10 ? code : 0xFFFF;
}

// Name of the panel with that security code, or nullptr.
static const char* panelBySecurity(uint16_t sec) {
  for (uint8_t i = 0; i < kPanelCount; ++i)
    if (panelCode[i] == sec) return kPanels[i].name;
  return nullptr;
}

static void pushLog(const String& line) {
  LogGuard guard;
  if (logCount == kLogEntries) {   // full: the oldest entry makes room
    for (uint8_t i = 0; i < kLogEntries - 1; ++i) {
      logLines[i] = logLines[i + 1];
      logTimes[i] = logTimes[i + 1];
    }
    logCount = kLogEntries - 1;
  }
  logLines[logCount] = line;
  logTimes[logCount] = clockStamp();
  Serial.print(logTimes[logCount]);
  Serial.print("  ");
  Serial.println(line);
  ++logCount;
}

static String describe(uint32_t f) {
  const velux::Frame r = velux::decode(f);
  String s = hex24(f);
  s += "  ";
  s += velux::actionName(r.action);
  s += " / ";
  s += velux::motorName(r.motor);
  s += " / set ";
  s += (r.set == 0) ? String("all") : String(r.set);
  s += " / sec ";
  s += bin(r.security, 10);
  const char* p = panelBySecurity(r.security);
  if (p) {
    s += " [";
    s += p;
    s += ']';
  }
  if (!velux::checksumOk(f)) s += "  (unexpected checksum!)";
  return s;
}

// ------------------------------ IR TX ---------------------------------------
//
// The RMT peripheral plays the frame in hardware, carrier included: one
// symbol per bit, mark (carrier on) then space, 1 tick = 1 us like the
// timings in VeluxIR.h. The channel only exists while a frame goes out: an
// enabled RMT channel holds a power-management lock that would keep the chip
// out of light sleep.
static const uint32_t kRmtTickHz  = 1000000;
static const uint32_t kRmtTimeout = 500;   // ms; a frame lasts ~40 ms
// Which signal level lights the LED (kIrActiveLow in Config.h): the Gravity
// DFR0095 module lights its LED when the signal is LOW, so there idle is
// HIGH and the marks (carrier) are LOW. A wrong setting leaves the LED
// permanently lit - the keypads then never see a pulse.
static const uint8_t kIrOn  = kIrActiveLow ? 0 : 1;
static const uint8_t kIrOff = kIrActiveLow ? 1 : 0;

static void irIdle() {
  pinMode(kIrTxPin, OUTPUT);
  digitalWrite(kIrTxPin, kIrOff);
}
// rmtSetCarrier()'s "carrier_level" argument ends up in the driver's
// polarity_active_low flag, i.e. inverted: it must be true when the marks
// are LOW (carrier applied while the level is low), false when they are HIGH.

// Web UI "IR LED test": the carrier runs continuously, to check the LED and
// its aim with a phone camera (an IR LED shows up as a bright violet-white
// dot). It switches itself off after kIrTestMaxMs - the LED draws tens of mA.
static const uint32_t kIrTestMaxMs = 10000;
static bool     irTestOn    = false;
static uint32_t irTestUntil = 0;

static void irTestSet(bool on) {
  if (on == irTestOn) {
    if (on) irTestUntil = millis() + kIrTestMaxMs;   // pressed again: restart the clock
    return;
  }
  if (on) {
    static rmt_data_t sym[1];                       // must outlive the transmission
    sym[0].level0 = kIrOn;  sym[0].duration0 = 32767;   // carrier on, both halves
    sym[0].level1 = kIrOn;  sym[0].duration1 = 32767;
    if (!rmtInit(kIrTxPin, RMT_TX_MODE, RMT_MEM_NUM_BLOCKS_1, kRmtTickHz)) return;
    if (!rmtSetCarrier(kIrTxPin, true, kIrActiveLow, velux::kCarrierHz, 0.5f) ||
        !rmtWriteLooping(kIrTxPin, sym, 1)) {
      rmtDeinit(kIrTxPin);
      return;
    }
    irTestUntil = millis() + kIrTestMaxMs;
  } else {
    rmtDeinit(kIrTxPin);
    irIdle();   // IR LED off
  }
  irTestOn = on;
  pushLog(on ? "--  IR LED test on" : "--  IR LED test off");
}

static void irTestTimeout() {
  if (irTestOn && (int32_t)(millis() - irTestUntil) >= 0) irTestSet(false);
}

static void sendFrame(uint32_t frame) {
  CmdGuard guard;     // one frame at a time, whoever asks
  irTestSet(false);   // the test owns the RMT channel
  uint16_t raw[velux::kRawLen];
  velux::toRaw(frame, raw);
  rmt_data_t sym[velux::kBits];
  for (uint8_t i = 0; i < velux::kBits; ++i) {
    sym[i].level0 = kIrOn;   sym[i].duration0 = raw[2 * i];       // mark
    sym[i].level1 = kIrOff;  sym[i].duration1 = raw[2 * i + 1];   // space
  }

  PmBusy busy;   // full clock, no light sleep until done
  const uint32_t t0 = millis();
  uint32_t gapMs = 0;
  bool ok = rmtInit(kIrTxPin, RMT_TX_MODE, RMT_MEM_NUM_BLOCKS_1, kRmtTickHz);
  if (ok) {
    rmtSetEOT(kIrTxPin, kIrOff);   // the line rests "LED off" between and after frames
    ok = rmtSetCarrier(kIrTxPin, true, kIrActiveLow, velux::kCarrierHz, 0.5f) &&
         rmtWrite(kIrTxPin, sym, velux::kBits, kRmtTimeout);   // the WLR 100 sends the frame
    const uint32_t g0 = millis();
    delay(velux::kRepeatGapMs);                                 // twice in a row
    gapMs = millis() - g0;
    ok = ok && rmtWrite(kIrTxPin, sym, velux::kBits, kRmtTimeout);
    rmtDeinit(kIrTxPin);
  }
  // Timing check for the USB log: a frame is ~97 ms in all (2 x 39 + 19); a
  // longer gap between the copies means the CPU was busy elsewhere.
  Serial.printf("[%lu ms] IR frame: %lu ms in all, %lu ms between the two copies (nominal %u)\n",
                (unsigned long)millis(), (unsigned long)(millis() - t0), (unsigned long)gapMs,
                (unsigned)velux::kRepeatGapMs);
  irIdle();      // IR LED off until the next frame
  if (stopPendingCover < 0) delay(60);   // a gap before any next frame - but not before a STOP

  pushLog(String(ok ? "TX  " : "!!  IR transmit FAILED: ") + describe(frame));
}

// ------------------------------ battery -------------------------------------

// Typical resting discharge curve of a single Li-ion/LiPo cell: voltage (mV,
// strictly decreasing) -> state of charge (%). Interpolated linearly between
// points. The curve is flat in the middle, so a few mV of ADC error there is
// worth several percent - see kBatteryCalibration in Config.h.
struct SocPoint { uint16_t mv; uint8_t pct; };
static const SocPoint kLiIonCurve[] = {
  {4200, 100}, {4150, 95}, {4110, 90}, {4080, 85}, {4020, 80}, {3980, 75},
  {3950,  70}, {3910, 65}, {3870, 60}, {3850, 55}, {3840, 50}, {3820, 45},
  {3800,  40}, {3790, 35}, {3770, 30}, {3750, 25}, {3730, 20}, {3710, 15},
  {3690,  10}, {3610,  5}, {3270,  0},
};
static const uint32_t kBatterySampleMs = 60000;   // the cell changes over hours

static float batteryMv = -1;   // smoothed battery voltage; < 0 = no reading yet

static uint8_t batteryPercent(float mv) {
  const uint8_t n = sizeof(kLiIonCurve) / sizeof(kLiIonCurve[0]);
  if (mv >= kLiIonCurve[0].mv) return 100;
  if (mv <= kLiIonCurve[n - 1].mv) return 0;
  uint8_t i = 1;
  while (mv < kLiIonCurve[i].mv) ++i;
  const SocPoint& hi = kLiIonCurve[i - 1];
  const SocPoint& lo = kLiIonCurve[i];
  return lo.pct + (uint8_t)((mv - lo.mv) * (hi.pct - lo.pct) / (hi.mv - lo.mv) + 0.5f);
}

// One burst of 16 readings, averaged, then folded into an exponential moving
// average: the ADC is noisy on its own and Wi-Fi transmit bursts move
// the supply around on top of that, while the battery itself only changes
// over hours - so heavy smoothing costs nothing.
static void sampleBattery() {
  PmBusy busy;                                     // steady clocks while the ADC converts
  uint32_t mvSum = 0;
  for (uint8_t i = 0; i < 16; ++i) mvSum += analogReadMilliVolts(kBatteryPin);   // eFuse-calibrated
  const float mv = (mvSum / 16.0f) * (kBatteryRTopOhm + kBatteryRBottomOhm) /
                   kBatteryRBottomOhm * kBatteryCalibration;
  batteryMv = (batteryMv < 0) ? mv : batteryMv + 0.2f * (mv - batteryMv);
}

// A reading in the battery history (and a line on the USB log) every
// kBatteryLogMs, plus one at boot: a record of how fast the battery drains,
// e.g. after changing a power setting. Written from the loop's regular
// wake-up, never a wake of its own.
static const uint32_t kBatteryLogMs = 2UL * 60 * 60 * 1000;   // 2h
static uint32_t batteryLastLog = 0;

// The same readings, kept in flash (NVS, namespace "bathist") for a week so
// they survive restarts and a flat battery: one record per key, r0..r83 in a
// ring, "head" = next slot to overwrite. Each reading writes a few dozen
// bytes 12 times a day - negligible flash wear. Read by /api/battery/history.
struct BatteryRecord {
  uint32_t time;     // Unix time (UTC) from NTP; 0 = clock not set yet
  uint32_t uptime;   // seconds since that restart
  uint16_t mv;
  uint8_t  pct;
  uint8_t  flags;    // kBatRecBoot
};
static const uint8_t kBatteryHistoryLen = 84;   // 7 days x 12 readings
static const uint8_t kBatRecBoot = 2;           // first reading after a restart

static void batteryHistoryKey(uint8_t slot, char* key, size_t len) {
  snprintf(key, len, "r%u", (unsigned)slot);
}

static void storeBatteryRecord(const BatteryRecord& r) {
  prefs.begin("bathist", false);
  const uint8_t head = prefs.getUChar("head", 0) % kBatteryHistoryLen;
  char key[8];
  batteryHistoryKey(head, key, sizeof(key));
  prefs.putBytes(key, &r, sizeof(r));
  prefs.putUChar("head", (head + 1) % kBatteryHistoryLen);
  prefs.end();
}

static void logBattery(bool boot = false) {
  if (batteryMv < 0) return;

  BatteryRecord r;
  const time_t now = time(nullptr);
  r.time   = (now > 1700000000) ? (uint32_t)now : 0;   // before NTP the clock reads ~1970
  r.uptime = millis() / 1000;
  r.mv     = (uint16_t)(batteryMv + 0.5f);
  r.pct    = batteryPercent(batteryMv);
  r.flags  = boot ? kBatRecBoot : 0;
  storeBatteryRecord(r);

  String s = "BAT  up ";
  s += formatUptime(millis() / 1000);
  s += "  battery ";
  s += batteryPercent(batteryMv);
  s += "% (";
  s += String(batteryMv / 1000.0f, 2);
  s += " V)";
  // Not in the frame log (commands only): the readings are in the battery
  // history. The USB log gets the line.
  Serial.print(clockStamp());
  Serial.print("  ");
  Serial.println(s);
  batteryLastLog = millis();
}

static void handleBattery() {
  static uint32_t lastSample = 0;
  const uint32_t now = millis();
  if ((uint32_t)(now - lastSample) < kBatterySampleMs) return;
  lastSample = now;
  sampleBattery();
  if ((uint32_t)(now - batteryLastLog) >= kBatteryLogMs) logBattery();
}

// ------------------------------ HTTP ----------------------------------------

static void sendJson(const String& body) {
  server.send(200, "application/json", body);
}

static void fail(const char* msg) {
  String j = "{\"error\":\"";
  j += jsonEscape(msg);
  j += "\"}";
  server.send(400, "application/json", j);
}

// Everything that isn't a value we generate ourselves goes through
// jsonEscape(): log lines can carry an uploaded file's name, and one stray
// quote there used to break /api/status for good (until reboot or Clear).
static void handleStatus() {
  String j = "{\"version\":\"";
  j += kVersion;
  j += "\",\"hostname\":\"";
  j += jsonEscape(kHostname);
  j += "\",\"apName\":\"";
  j += jsonEscape(kApSsid);
  j += "\",\"staConnected\":";
  j += staConnected ? "true" : "false";
  j += ",\"apActive\":";
  j += apActive ? "true" : "false";
  j += ",\"ip\":\"";
  j += staConnected ? WiFi.localIP().toString() : String();
  j += "\",\"apIp\":\"";
  j += apActive ? WiFi.softAPIP().toString() : String();
  j += "\",\"apSsid\":\"";
  j += apActive ? jsonEscape(kApSsid) : String();
  j += "\",\"mode\":\"";
  if (staConnected && apActive) j += "Wi-Fi (access point closing)";
  else if (staConnected)        j += "connected to Wi-Fi";
  else if (apActive)            j += "Access Point (setup)";
  else                          j += "disconnected";
  j += "\",\"ssid\":\"";
  j += staConnected ? jsonEscape(WiFi.SSID()) : String();
  j += "\",\"panels\":[";
  for (uint8_t i = 0; i < kPanelCount; ++i) {
    if (i) j += ',';
    j += "{\"name\":\"";
    j += jsonEscape(kPanels[i].name);
    j += "\",\"sec\":\"";
    j += (panelCode[i] == 0xFFFF) ? String("INVALID") : bin(panelCode[i], 10);
    j += "\",\"ok\":";
    j += (panelCode[i] == 0xFFFF) ? "false" : "true";
    j += ",\"motors\":[";
    for (uint8_t m = 0; m < 3; ++m) {
      if (m) j += ',';
      j += '"';
      j += jsonEscape(kPanels[i].motor[m]);
      j += '"';
    }
    j += "]}";
  }
  {
    LogGuard guard;   // the log is also written by the Zigbee command task
    j += "],\"log\":[";
    for (uint8_t i = 0; i < logCount; ++i) {
      if (i) j += ',';
      j += '"';
      j += jsonEscape(logLines[i]);
      j += '"';
    }
    j += "],\"logTimes\":[";
    for (uint8_t i = 0; i < logCount; ++i) {
      if (i) j += ',';
      j += '"';
      j += jsonEscape(logTimes[i]);
      j += '"';
    }
  }
  j += "],\"rssi\":\"";
  j += staConnected ? (String(WiFi.RSSI()) + " dBm") : String("n/a");
  j += "\",\"cpuMhz\":";
  j += getCpuFrequencyMhz();
  j += ",\"heapFree\":";
  j += ESP.getFreeHeap();
  j += ",\"heapMin\":";
  j += ESP.getMinFreeHeap();
  j += ",\"uptime\":\"";
  j += formatUptime(millis() / 1000);
  j += "\",\"resetReason\":\"";
  {
    // Same helper the boot banner uses, trimmed to the short label: the
    // detailed advice (e.g. for BROWNOUT) belongs on the serial console at
    // boot, not squeezed into a one-line status row here.
    String rr = resetReasonName(esp_reset_reason());
    const int cut = rr.indexOf(" - ");
    if (cut > 0) rr = rr.substring(0, cut);
    j += rr;
  }
  j += "\",\"mac\":\"";
  j += WiFi.macAddress();
  j += "\",\"powerMgmt\":\"";
  j += pmStatus;
  j += "\",\"wifiPowerSave\":\"";
  j += apActive ? "off (access point running)" : wifiPsName(kWifiPowerSave);
  j += "\",\"zigbee\":\"";
  j += zigbeeStatus();
  j += "\",\"usbLog\":";
  j += usbLog ? "true" : "false";
  j += ",\"usbLogSaved\":";
  j += usbLogSaved() ? "true" : "false";
  j += ",\"irTest\":";
  j += irTestOn ? "true" : "false";
  j += ",\"zigbeePaired\":";
  j += zbPairedFlag() ? "true" : "false";
  j += ",\"zigbeePairing\":";
  j += zigbeePairing() ? "true" : "false";
  j += ",\"battery\":";
  if (batteryMv < 0) {
    j += "null";
  } else {
    const uint8_t pct = batteryPercent(batteryMv);
    j += "{\"percent\":";
    j += pct;
    j += ",\"voltage\":";
    j += String(batteryMv / 1000.0f, 2);
    j += ",\"capacityMah\":";
    j += kBatteryCapacityMah;
    j += ",\"remainingMah\":";
    j += (uint32_t)kBatteryCapacityMah * pct / 100;
    j += '}';
  }
  j += '}';
  sendJson(j);
}

// How long after an open or close the actuators of keypad p may still be
// travelling: the full travel time of that kind of motor plus a margin.
static uint32_t travelWindowMs(int p) {
  return (kPanels[p].kind == kCoverBlind ? kTravelTimeBlindMs : kTravelTimeWindowMs) + kTravelMarginMs;
}

// ------------------------------ position estimate ---------------------------
//
// The IR protocol never reports back, so the position is worked out from the
// travel time: an actuator moves at a constant speed, so in
// kTravelTime*Ms it covers 100%. An open or close starts it moving, a STOP
// (or a reversal's STOP) freezes it, and reaching an end stops the estimate
// there - which also corrects any drift, since after a full run the position
// is known again. Home Assistant gets the estimate over Zigbee (see
// handlePositions); at boot the position is unknown (kZigbeeStartLiftPct).
// Raw frames sent by hand (/api/sendhex) are not tracked.
struct MotorPos {
  float    pct;    // Zigbee lift percentage: 0 = fully open, 100 = fully closed
  int8_t   dir;    // -1 opening, +1 closing, 0 standing still
  uint32_t since;  // millis() of pct
};
static MotorPos motorPos[kPanelCount][3];
static portMUX_TYPE posMux = portMUX_INITIALIZER_UNLOCKED;

static float fullTravelMs(int p) {   // the travel time without the safety margin
  return (float)(kPanels[p].kind == kCoverBlind ? kTravelTimeBlindMs : kTravelTimeWindowMs);
}

// Brings the estimate of one motor up to now. Call with posMux held.
static void posAdvance(int p, int i, uint32_t now) {
  MotorPos& s = motorPos[p][i];
  if (s.dir) {
    s.pct += s.dir * (float)(uint32_t)(now - s.since) * 100.0f / fullTravelMs(p);
    if (s.pct <= 0)   { s.pct = 0;   s.dir = 0; }
    if (s.pct >= 100) { s.pct = 100; s.dir = 0; }
  }
  s.since = now;
}

// A frame has gone out: the addressed motors start moving (open / close) or
// stand still (STOP). m = motor 0..2, 3 = all three.
static void posCommand(int p, int m, int a) {
  const uint32_t now = millis();
  portENTER_CRITICAL(&posMux);
  for (int i = (m == 3 ? 0 : m); i <= (m == 3 ? 2 : m); ++i) {
    posAdvance(p, i, now);
    motorPos[p][i].dir = (a == 0) ? -1 : (a == 2) ? +1 : 0;
  }
  portEXIT_CRITICAL(&posMux);
}

// One open/stop/close command, anti-jam logic included - shared by the HTTP
// API and Zigbee. p = panel, m = motor 0..2 or 3 = all three, a: 0 = open,
// 1 = stop, 2 = close (index into kActions[]). Returns nullptr on success,
// otherwise what was wrong. *autoStop tells whether a STOP had to go first.
static const char* runCommand(int p, int m, int a, bool* autoStop) {
  if (p < 0 || p >= kPanelCount) return "invalid panel";
  if (m < 0 || m > 3 || a < 0 || a > 2) return "invalid motor or action";
  if (panelCode[p] == 0xFFFF) return "invalid security code in Config.h";

  // A STOP announces itself before taking the lock: a command in progress
  // (it holds the lock, in its pause) sees it and gives way at once.
  if (a == 1) stopPendingCover = p * 4 + m;
  CmdGuard guard;

  bool autoStopSent = false;

  // A STOP for this motor is already on its way: this command is obsolete.
  if (a != 1 && stopCovers(stopPendingCover, p, m)) return "cancelled: a STOP followed";

  if (a == 1) {                              // STOP: always allowed, clears the cooldown
    if (m == 3) {
      for (uint8_t i = 0; i < 4; ++i) lastDirAction[p][i] = -1;
    } else {
      lastDirAction[p][m] = -1;
    }
  } else {                                   // open (0) or close (2)
    const uint32_t now = millis();
    const uint32_t travelMs = travelWindowMs(p);

    // Check if any addressed motor is currently moving in the opposite direction
    bool needAutoStop = false;
    if (m == 3) {
      for (uint8_t i = 0; i < 4; ++i) {
        if (lastDirAction[p][i] >= 0 && lastDirAction[p][i] != a &&
            (uint32_t)(now - lastDirTime[p][i]) < travelMs) {
          needAutoStop = true;
          break;
        }
      }
    } else {
      if ((lastDirAction[p][m] >= 0 && lastDirAction[p][m] != a &&
           (uint32_t)(now - lastDirTime[p][m]) < travelMs) ||
          (lastDirAction[p][3] >= 0 && lastDirAction[p][3] != a &&
           (uint32_t)(now - lastDirTime[p][3]) < travelMs)) {
        needAutoStop = true;
      }
    }

    if (needAutoStop) {
      // Actuator is actively travelling in reverse: send STOP first to prevent WLC 100 fault/lockout
      sendFrame(velux::build(velux::ACT_STOP, kMotors[m], panelCode[p]));
      posCommand(p, m, 1);   // the motor stands still during the pause
      autoStopSent = true;
      // Pause for the motor to settle - cut short, and the new direction
      // dropped, if a STOP for it arrives meanwhile.
      for (uint32_t t = 0; t < kAutoStopPauseMs; t += 10) {
        if (stopCovers(stopPendingCover, p, m)) return "cancelled: a STOP followed";
        delay(10);
      }
    }

    const uint32_t sendTime = millis();
    if (m == 3) {
      for (uint8_t i = 0; i < 4; ++i) {
        lastDirAction[p][i] = a;
        lastDirTime[p][i] = sendTime;
      }
    } else {
      lastDirAction[p][m] = a;
      lastDirTime[p][m] = sendTime;
    }
  }

  sendFrame(velux::build(kActions[a], kMotors[m], panelCode[p]));
  posCommand(p, m, a);   // position estimate: the motors now move / stand still
  if (a == 1 && stopPendingCover == p * 4 + m) stopPendingCover = -1;   // the STOP has gone out
  if (autoStop) *autoStop = autoStopSent;
  return nullptr;
}

static void handleSend() {
  const int p = server.arg("panel").toInt();
  const int m = server.arg("motor").toInt();
  const int a = server.arg("action").toInt();
  bool autoStop = false;
  const char* err = runCommand(p, m, a, &autoStop);
  if (err) { fail(err); return; }
  sendJson(autoStop ? "{\"ok\":true,\"autoStop\":true}" : "{\"ok\":true}");
}

static void handleSendHex() {
  String v = server.arg("v");
  v.trim();
  uint32_t frame = 0;
  if (v.length() == 24 && v.indexOf('x') < 0) {
    for (uint8_t i = 0; i < 24; ++i) frame = (frame << 1) | (v[i] == '1' ? 1 : 0);
  } else {
    frame = (uint32_t)strtoul(v.c_str(), nullptr, 0) & 0xFFFFFF;
  }
  if (!frame) { fail("invalid frame"); return; }
  sendFrame(frame);
  sendJson("{\"ok\":true}");
}

// The week of battery readings kept in flash, oldest first:
// [{"t":unix|0,"up":s,"mv":mV,"pct":%,"boot":bool}, ...]
static void handleBatteryHistory() {
  String j = "[";
  prefs.begin("bathist", true);
  const uint8_t head = prefs.getUChar("head", 0) % kBatteryHistoryLen;
  bool first = true;
  for (uint8_t k = 0; k < kBatteryHistoryLen; ++k) {
    char key[8];
    batteryHistoryKey((head + k) % kBatteryHistoryLen, key, sizeof(key));
    BatteryRecord r;
    if (!prefs.isKey(key) || prefs.getBytes(key, &r, sizeof(r)) != sizeof(r)) continue;
    if (!first) j += ',';
    first = false;
    j += "{\"t\":";
    j += r.time;
    j += ",\"up\":";
    j += r.uptime;
    j += ",\"mv\":";
    j += r.mv;
    j += ",\"pct\":";
    j += r.pct;
    j += ",\"boot\":";
    j += (r.flags & kBatRecBoot) ? "true" : "false";
    j += '}';
  }
  prefs.end();
  j += ']';
  sendJson(j);
}

static void handleBatteryHistoryClear() {
  prefs.begin("bathist", false);
  prefs.clear();
  prefs.end();
  sendJson("{\"ok\":true}");
}

// Reference frames for the web UI's raw-frame guide: for each keypad, what
// the grid buttons send for its first motor and for all three, in the order
// open/stop/close. Built by the same code as the real commands, so the guide
// follows Config.h instead of going stale when a security code changes.
static void handleFrames() {
  String j = "[";
  for (uint8_t i = 0; i < kPanelCount; ++i) {
    const bool ok = panelCode[i] != 0xFFFF;
    if (i) j += ',';
    j += "{\"name\":\"";
    j += jsonEscape(kPanels[i].name);
    j += "\",\"motor\":\"";
    j += jsonEscape(kPanels[i].motor[0]);
    j += "\",\"ok\":";
    j += ok ? "true" : "false";
    j += ",\"frames\":[";
    for (uint8_t k = 0; k < 6; ++k) {
      if (k) j += ',';
      j += '"';
      if (ok) j += hex24(velux::build(kActions[k % 3], kMotors[k < 3 ? 0 : 3], panelCode[i]));
      j += '"';
    }
    j += "]}";
  }
  j += ']';
  sendJson(j);
}

// Scans for nearby Wi-Fi networks and returns them as a JSON array, sorted by
// signal strength (strongest first), de-duplicated by SSID and with hidden
// (blank-SSID) networks skipped since there is nothing to click on for those.
// This is a blocking call (a couple of seconds) - acceptable here since it
// only runs when the user presses "Scan networks" in the web UI. Requires
// the STA radio to be active, which is why setupWifi() below always enables
// it (WIFI_AP_STA / WIFI_STA), even while only running as a setup access
// point.
static void handleWifiScan() {
  const int n = WiFi.scanNetworks();

  // Sort indices by RSSI descending (simple insertion sort - n is always
  // small, a few dozen networks at most).
  static int order[64];
  const int count = (n < 0) ? 0 : (n > 64 ? 64 : n);
  for (int i = 0; i < count; ++i) order[i] = i;
  for (int i = 1; i < count; ++i) {
    const int key = order[i];
    const int keyRssi = WiFi.RSSI(key);
    int k = i - 1;
    while (k >= 0 && WiFi.RSSI(order[k]) < keyRssi) { order[k + 1] = order[k]; --k; }
    order[k + 1] = key;
  }

  static String seen[64];
  uint8_t seenCount = 0;
  String j = "[";
  bool first = true;
  for (int i = 0; i < count; ++i) {
    const int ni = order[i];
    const String ssid = WiFi.SSID(ni);
    if (!ssid.length()) continue;               // hidden network, nothing to select
    bool dup = false;
    for (uint8_t k = 0; k < seenCount; ++k)
      if (seen[k] == ssid) { dup = true; break; }
    if (dup) continue;
    if (seenCount < 64) seen[seenCount++] = ssid;

    if (!first) j += ',';
    first = false;
    j += "{\"ssid\":\"";
    j += jsonEscape(ssid);
    j += "\",\"rssi\":";
    j += WiFi.RSSI(ni);
    j += ",\"secure\":";
    j += (WiFi.encryptionType(ni) == WIFI_AUTH_OPEN) ? "false" : "true";
    j += "}";
  }
  j += "]";
  WiFi.scanDelete();
  sendJson(j);
}

static void handleWifi() {
  const String body = server.arg("plain");
  String ssid, pass;
  if (!jsonStringField(body, "ssid", ssid) || !jsonStringField(body, "pass", pass)) {
    fail("invalid json");
    return;
  }
  if (!ssid.length()) { fail("empty SSID"); return; }
  if (ssid.length() > 32) { fail("SSID too long (max 32 bytes)"); return; }
  // WPA2: 8-63 characters, or a 64-digit hex key. Empty = open network.
  if (pass.length() && (pass.length() < 8 || pass.length() > 64)) {
    fail("password must be 8-63 characters (or empty for an open network)");
    return;
  }

  prefs.begin("velux", false);
  prefs.putString("ssid", ssid);
  prefs.putString("pass", pass);
  prefs.end();

  sendJson("{\"ok\":true}");
  delay(300);
  restartBoard();
}

// Password for the board's own setup access point (kApSsid). A value saved
// here in NVS overrides the kApPassword compiled into Config.h - the
// opposite priority from the home-network credentials above, on purpose:
// the whole point of this endpoint is to let you change it without
// reflashing, so once you have changed it here it should stick, not get
// silently overridden by whatever is still in Config.h.
static String currentApPassword() {
  prefs.begin("velux", true);
  const String p = prefs.getString("appass", "");
  prefs.end();
  return p.length() ? p : String(kApPassword);
}

static void handleApPassword() {
  const String body = server.arg("plain");
  String pass;
  if (!jsonStringField(body, "pass", pass)) { fail("invalid json"); return; }
  // WPA2-PSK requires 8-63 characters; empty is accepted here as "reset to
  // the Config.h default", not as "make the AP open" - open would be a
  // surprising, easy-to-trigger-by-accident outcome for a password field.
  if (pass.length() > 0 && pass.length() < 8) {
    fail("password must be at least 8 characters (or empty to reset to the default)");
    return;
  }
  if (pass.length() > 63) { fail("password too long (max 63 characters)"); return; }

  prefs.begin("velux", false);
  if (pass.length()) prefs.putString("appass", pass);
  else prefs.remove("appass");
  prefs.end();

  sendJson("{\"ok\":true}");
  delay(300);
  restartBoard();
}

// The USB log switch of the web UI: stored in NVS, applied at the next boot
// (the console and light sleep are set up before anything else runs).
static bool usbLogSaved() {
  prefs.begin("velux", true);
  const bool on = prefs.getUChar("usblog", kUsbLogDefault ? 1 : 0) != 0;
  prefs.end();
  return on;
}

// The Zigbee card of the web UI: pairing is only started from here.
static void handleZigbeePair() {
  if (!zbRequestPair()) {
    sendJson("{\"ok\":true,\"note\":\"already paired: forget the network first to pair again\"}");
    return;
  }
  sendJson("{\"ok\":true}");
}

static void handleZigbeeForget() {
  zbRequestForget();
  sendJson("{\"ok\":true}");
}

// Body {"enabled":true|false}: the "IR LED test" button of the web UI.
static void handleIrTest() {
  const String body = server.arg("plain");
  const int k = body.indexOf("\"enabled\"");
  const int colon = (k < 0) ? -1 : body.indexOf(':', k);
  if (colon < 0) { fail("invalid json"); return; }
  String v = body.substring(colon + 1);
  v.trim();
  irTestSet(v.startsWith("true"));
  sendJson(String("{\"ok\":true,\"irTest\":") + (irTestOn ? "true" : "false") + "}");
}

static void handleUsbLog() {
  const String body = server.arg("plain");
  const int k = body.indexOf("\"enabled\"");
  const int colon = (k < 0) ? -1 : body.indexOf(':', k);
  if (colon < 0) { fail("invalid json"); return; }
  String v = body.substring(colon + 1);
  v.trim();
  prefs.begin("velux", false);
  prefs.putUChar("usblog", v.startsWith("true") ? 1 : 0);
  prefs.end();
  sendJson("{\"ok\":true}");
}

// ------------------------------ firmware update -----------------------------
//
// Flashes a new firmware .bin uploaded through the web UI, using the chip's
// own OTA machinery (the same one ArduinoOTA uses). Two things worth knowing:
//
//   - Wi-Fi credentials and every setting live in a separate NVS partition,
//     not in the application partition this overwrites - they survive an
//     update with no extra code needed to "preserve" them.
//   - There is no authentication on this (or any other) endpoint, matching
//     the rest of this project's LAN-only threat model. Anyone who can reach
//     this page on your network can flash arbitrary firmware onto the board.
//     If that's a concern on your network, don't expose this device beyond
//     your LAN (no port forwarding), same advice as for the rest of the API.
static bool updateFailed = false;

static void handleFirmwareUpload() {
  HTTPUpload& upload = server.upload();
  if (upload.status == UPLOAD_FILE_START) {
    updateFailed = false;
    pushLog(String("--  firmware update starting: ") + upload.filename);
    holdAwakeForUpdate(true);
    if (!Update.begin(UPDATE_SIZE_UNKNOWN)) {
      updateFailed = true;
      Update.printError(Serial);
    }
  } else if (upload.status == UPLOAD_FILE_WRITE && !updateFailed) {
    if (Update.write(upload.buf, upload.currentSize) != upload.currentSize) {
      updateFailed = true;
      Update.printError(Serial);
    }
  } else if (upload.status == UPLOAD_FILE_END && !updateFailed) {
    if (Update.end(true)) {
      pushLog(String("OK  firmware update complete: ") + upload.totalSize + " bytes, rebooting");
    } else {
      updateFailed = true;
      Update.printError(Serial);
    }
  } else if (upload.status == UPLOAD_FILE_ABORTED) {
    updateFailed = true;
    pushLog("--  firmware update aborted by the client");
    holdAwakeForUpdate(false);
  }
}

// Runs after handleFirmwareUpload() has streamed the whole file. Sends the
// final result, then reboots into the new firmware (or, on failure, back
// into this same one - the currently running app is only replaced once the
// new image is verified complete, so a failed/aborted upload leaves the
// board exactly as it was).
static void handleFirmwareResult() {
  if (updateFailed || Update.hasError()) {
    String msg = "update failed: ";
    msg += Update.errorString();
    pushLog(String("!!  ") + msg);
    fail(msg.c_str());
    holdAwakeForUpdate(false);
    return;
  }
  server.sendHeader("Connection", "close");
  sendJson("{\"ok\":true}");
  delay(1000);
  restartBoard();
}

static void setupHttp() {
  server.on("/", HTTP_GET, [] {
    server.sendHeader("Content-Encoding", "gzip");
    server.send_P(200, "text/html", (const char*)kIndexHtmlGz, sizeof(kIndexHtmlGz));
  });
  server.on("/api/status",    HTTP_GET,  handleStatus);
  server.on("/api/frames",    HTTP_GET,  handleFrames);
  server.on("/api/battery/history",       HTTP_GET,  handleBatteryHistory);
  server.on("/api/battery/history/clear", HTTP_POST, handleBatteryHistoryClear);
  server.on("/api/send",      HTTP_POST, handleSend);
  server.on("/api/sendhex",   HTTP_POST, handleSendHex);
  server.on("/api/wifi",      HTTP_POST, handleWifi);
  server.on("/api/appassword",HTTP_POST, handleApPassword);
  server.on("/api/usblog",    HTTP_POST, handleUsbLog);
  server.on("/api/irtest",    HTTP_POST, handleIrTest);
  server.on("/api/zigbeepair",   HTTP_POST, handleZigbeePair);
  server.on("/api/zigbeeforget", HTTP_POST, handleZigbeeForget);
  server.on("/api/wifiscan",  HTTP_GET,  handleWifiScan);
  server.on("/api/update",    HTTP_POST, handleFirmwareResult, handleFirmwareUpload);
  server.on("/api/log/clear", HTTP_POST, [] { logCount = 0; sendJson("{\"ok\":true}"); });
  server.on("/api/reboot",    HTTP_POST, [] {
    sendJson("{\"ok\":true}");
    delay(500);   // give the client a moment to receive the response first
    restartBoard();
  });
  server.onNotFound([] { server.send(404, "text/plain", "not found"); });
  server.enableDelay(false);   // loop() paces itself in waitForWork()
  server.begin();
}

// ------------------------------ Wi-Fi ---------------------------------------

static void startAp() {
  if (apActive) return;
  WiFi.mode(WIFI_AP_STA);
  WiFi.setTxPower(kWifiTxPower);
  if (kWifiNarrowBandwidth) {
    esp_wifi_set_bandwidth(WIFI_IF_AP, WIFI_BW_HT20);
    esp_wifi_set_bandwidth(WIFI_IF_STA, WIFI_BW_HT20);
  }
  const String apPass = currentApPassword();
  WiFi.softAP(kApSsid, apPass.c_str());
  apActive = true;
  Serial.printf("Access point \"%s\" -> http://%s\n", kApSsid,
                WiFi.softAPIP().toString().c_str());
}

static void stopAp() {
  if (!apActive) return;
  WiFi.softAPdisconnect(true);
  WiFi.mode(WIFI_STA);
  WiFi.setTxPower(kWifiTxPower);
  if (kWifiNarrowBandwidth) {
    esp_wifi_set_bandwidth(WIFI_IF_STA, WIFI_BW_HT20);
  }
  apActive = false;
  Serial.println("Access point off (connected to Wi-Fi).");
}

// WiFi.begin(ssid, pass) plus the listen interval (kWifiListenInterval),
// which the Arduino core doesn't expose and resets to the default on every
// begin(ssid, pass): set the credentials without connecting, patch the
// driver's station config, then connect with that stored config. The core's
// automatic reconnects and WiFi.reconnect() reuse it, so it sticks.
static void wifiBeginSta() {
  WiFi.begin(configuredSsid.c_str(), configuredPass.c_str(), 0, nullptr, false);
  wifi_config_t conf;
  if (esp_wifi_get_config(WIFI_IF_STA, &conf) == ESP_OK) {
    conf.sta.listen_interval = kWifiListenInterval;
    esp_wifi_set_config(WIFI_IF_STA, &conf);
  }
  WiFi.begin();
}

static void setupWifi() {
  // A hardcoded SSID (kWifiSsid, at the top of this file) always wins over
  // whatever was saved from the web UI. Otherwise fall back to the
  // credentials stored in flash (NVS) by a previous /api/wifi call.
  configuredSsid = kWifiSsid;
  configuredPass = kWifiPassword;
  if (!configuredSsid.length()) {
    prefs.begin("velux", true);
    configuredSsid = prefs.getString("ssid", "");
    configuredPass = prefs.getString("pass", "");
    prefs.end();
  }

  WiFi.setHostname(kHostname);
  // USB log of what the radio does, to find out why the board becomes
  // unreachable (disconnect reasons are the interesting part).
  WiFi.onEvent([](WiFiEvent_t ev, WiFiEventInfo_t info) {
    switch (ev) {
      case ARDUINO_EVENT_WIFI_STA_CONNECTED:       Serial.println("Wi-Fi event: STA connected"); break;
      case ARDUINO_EVENT_WIFI_STA_DISCONNECTED:
        Serial.printf("Wi-Fi event: STA disconnected, reason %u\n", info.wifi_sta_disconnected.reason); break;
      case ARDUINO_EVENT_WIFI_STA_GOT_IP:          Serial.printf("Wi-Fi event: got IP %s\n", WiFi.localIP().toString().c_str()); break;
      case ARDUINO_EVENT_WIFI_STA_LOST_IP:         Serial.println("Wi-Fi event: lost IP"); break;
      case ARDUINO_EVENT_WIFI_AP_STACONNECTED:     Serial.println("Wi-Fi event: a client joined the access point"); break;
      case ARDUINO_EVENT_WIFI_AP_STADISCONNECTED:
        Serial.printf("Wi-Fi event: a client left the access point, reason %u\n", info.wifi_ap_stadisconnected.reason); break;
      default: break;
    }
  });
  if (configuredSsid.length()) {
    WiFi.mode(WIFI_STA);
    WiFi.setTxPower(kWifiTxPower);   // must come after mode(): driver needs to be up
    if (kWifiNarrowBandwidth) esp_wifi_set_bandwidth(WIFI_IF_STA, WIFI_BW_HT20);
    wifiBeginSta();
    Serial.printf("Connecting to %s", configuredSsid.c_str());
    const uint32_t until = millis() + 15000;
    while (WiFi.status() != WL_CONNECTED && millis() < until) {
      delay(400);
      Serial.print('.');
    }
    Serial.println();
  }
  staConnected = (WiFi.status() == WL_CONNECTED);
  if (staConnected) {
    Serial.printf("Connected: http://%s  (or http://%s.local)\n",
                  WiFi.localIP().toString().c_str(), kHostname);
  }

  // The access point runs only while we're NOT connected to a home network:
  // the setup fallback - nothing to reach the board with otherwise.
  if (!staConnected) startAp();
  WiFi.setSleep(kWifiPowerSave);    // see the note in Config.h; ignored while the AP runs
  MDNS.begin(kHostname);
  MDNS.addService("http", "tcp", 80);
}

// Non-blocking Wi-Fi watchdog: monitors connection status and handles
// progressive recovery when the home network drops, without interrupting IR
// reception or the web server.
static void handleWifiWatchdog() {
  if (!configuredSsid.length()) return;

  const uint32_t now = millis();
  static uint32_t lastCheck = 0;
  if ((uint32_t)(now - lastCheck) < kWifiWatchdogIntervalMs) return;
  lastCheck = now;

  static uint32_t lostSince = 0;
  static uint32_t lastAttempt = 0;
  static bool wasConnected = staConnected;

  const bool isConnected = (WiFi.status() == WL_CONNECTED);

  if (isConnected) {
    if (!wasConnected) {
      staConnected = true;
      wasConnected = true;
      lostSince = 0;
      lastAttempt = 0;
      Serial.printf("Wi-Fi reconnected: http://%s  (or http://%s.local)\n",
                    WiFi.localIP().toString().c_str(), kHostname);
      MDNS.begin(kHostname);
      MDNS.addService("http", "tcp", 80);
      stopAp();
    }
  } else {
    if (wasConnected) {
      wasConnected = false;
      staConnected = false;
      lostSince = now;
      lastAttempt = now;
      Serial.println("Wi-Fi disconnected. Watchdog monitoring connection...");
    }

    if (lostSince == 0) {
      lostSince = now;
      lastAttempt = now;
    }

    const uint32_t elapsed = (uint32_t)(now - lostSince);

    // If disconnected for longer than fallback grace period, enable emergency AP
    if (elapsed >= kWifiApFallbackGraceMs && !apActive) {
      Serial.println("Wi-Fi down > threshold: bringing up emergency setup AP...");
      startAp();
    }

    // Attempt periodic reconnect
    if ((uint32_t)(now - lastAttempt) >= kWifiReconnectGraceMs) {
      if (elapsed >= kWifiFullResetGraceMs) {
        Serial.printf("Wi-Fi still down (%us): performing clean reconnect to %s...\n",
                      (unsigned)(elapsed / 1000), configuredSsid.c_str());
        WiFi.disconnect();
        WiFi.setTxPower(kWifiTxPower);
        if (kWifiNarrowBandwidth) esp_wifi_set_bandwidth(WIFI_IF_STA, WIFI_BW_HT20);
        wifiBeginSta();
      } else {
        Serial.println("Wi-Fi down: triggering WiFi.reconnect()...");
        WiFi.reconnect();
      }
      lastAttempt = now;
    }
  }
}

// ------------------------------ setup/loop ----------------------------------

// Human-readable reason the chip just (re)booted. The one that matters here
// is ESP_RST_BROWNOUT: it means the board reset itself because its supply
// voltage sagged (typically a weak USB cable/adapter, or a current spike
// from the Wi-Fi radio or the IR LED) - NOT a Wi-Fi client disconnecting on
// its own. Any other reason after a mid-session dropout points the other
// way: the board never restarted, so whatever disconnected did so on its
// own (e.g. a phone/tablet auto-leaving a Wi-Fi network with no internet
// access, which is normal OS behaviour for this kind of setup access point).
static const char* resetReasonName(esp_reset_reason_t r) {
  switch (r) {
    case ESP_RST_POWERON:   return "power-on";
    case ESP_RST_EXT:       return "external reset pin";
    case ESP_RST_SW:        return "software reset (e.g. after Wi-Fi setup)";
    case ESP_RST_PANIC:     return "crash / panic";
    case ESP_RST_INT_WDT:   return "interrupt watchdog";
    case ESP_RST_TASK_WDT:  return "task watchdog";
    case ESP_RST_WDT:       return "other watchdog";
    case ESP_RST_DEEPSLEEP: return "woke from deep sleep";
    case ESP_RST_BROWNOUT:  return "BROWNOUT - supply voltage sagged, use a better power source";
    case ESP_RST_SDIO:      return "SDIO reset";
    default:                return "unknown";
  }
}

// ------------------------------ operating mode ------------------------------
//
// Decided once at boot from the mode switch (kWifiSwitchPin): Wi-Fi on (web
// UI, HTTP API, OTA) or off. Flipping the switch restarts the board into the
// other mode - simpler and sturdier than taking the whole network stack down
// and up at runtime, and Zigbee re-attaches to its parent within seconds.
static bool readWifiSwitch() {
  return digitalRead(kWifiSwitchPin) == HIGH;
}

// Debounce: acts only if the switch still reads flipped on the next pass of
// the loop (0.1-1s later).
static void handleModeSwitch() {
  static bool flipped = false;
  if (readWifiSwitch() == wifiEnabled) { flipped = false; return; }
  if (!flipped) { flipped = true; return; }
  Serial.printf("Mode switch turned %s: restarting\n", wifiEnabled ? "OFF (Zigbee only)" : "ON (Wi-Fi)");
  Serial.flush();
  restartBoard();
}

// ------------------------------ Zigbee --------------------------------------
//
// See Config.h §7. The board is a sleepy end device exposing one window
// covering per motor and one per keypad for "all three"
// (cover = panel*4 + motor, endpoint = kZigbeeFirstEndpoint + cover).
static const uint8_t kZbCovers    = kPanelCount * 4;
static const uint8_t kZbMaxCovers = 16;
static_assert(kZbCovers <= kZbMaxCovers, "too many keypads for the Zigbee cover table");

static ZigbeeWindowCovering* zbCovers[kZbMaxCovers] = {};
static bool zbStarted = false;

// Commands arrive in the Zigbee stack's own task. Sending one can take over
// a second (anti-jam STOP + pause) and must not stall the stack, so the
// callbacks only queue it and loop() sends it.
struct ZbCommand {
  uint8_t cover;
  uint8_t action;   // 0 open, 1 stop, 2 close
};
static QueueHandle_t zbQueue = nullptr;

// Poll rate. A sleepy end device only hears its parent when it asks, so the
// poll interval is the latency of every command (and of the pairing
// conversation with Home Assistant). Idle it asks every kZigbeePollMs; for
// kZigbeeFastPollHoldMs after joining and after each command it polls fast
// (the stack's "turbo poll"), since more traffic tends to follow.
static volatile uint32_t zbActiveAt = 0;   // millis() of the last activity; 0 = none yet

static void zbTouch() { zbActiveAt = millis() | 1; }

static void zbEnqueue(uint8_t cover, uint8_t action) {
  zbTouch();
  Serial.printf("[%lu ms] Zigbee: command received from the network (cover %u, action %u)\n",
                (unsigned long)millis(), cover, action);
  const ZbCommand c = {cover, action};
  if (!zbQueue) return;
  if (action != 1) { xQueueSend(zbQueue, &c, 0); return; }

  // STOP: first in line, and whatever it covers that is still waiting is
  // dropped - an "open" followed by a STOP must not open after the STOP.
  stopPendingCover = cover;
  ZbCommand keep[8], q;
  uint8_t n = 0;
  while (n < 8 && xQueueReceive(zbQueue, &q, 0) == pdTRUE) {
    if (q.action != 0 && q.action != 2) keep[n++] = q;                      // other STOPs, markers
    else if (!stopCovers(cover, q.cover / 4, q.cover % 4)) keep[n++] = q;   // other motors
  }
  for (uint8_t i = 0; i < n; ++i) xQueueSend(zbQueue, &keep[i], 0);
  xQueueSendToFront(zbQueue, &c, 0);
}

// Home Assistant's "Identify": the status LED pulses for kLedIdentifyMs (see
// handleStatusLed). Runs in the Zigbee task: it only sets the deadline and
// wakes loop() (which sleeps on a task notification) to start pulsing.
static volatile uint32_t ledIdentifyUntil = 0;   // millis() deadline; 0 = not identifying

static void zbIdentify(uint16_t) {
  zbTouch();
  ledIdentifyUntil = (millis() + kLedIdentifyMs) | 1;
  if (loopTask) xTaskNotifyGive(loopTask);
  pushLog("--  Zigbee identify: status LED pulsing");
}

// The library's callbacks don't say which endpoint they're for, so every
// cover gets its own set, generated at compile time.
template <size_t I> static void zbOpen()  { zbEnqueue(I, 0); }
template <size_t I> static void zbStop()  { zbEnqueue(I, 1); }
template <size_t I> static void zbClose() { zbEnqueue(I, 2); }
// Zigbee lift percentage: 0 = fully open, 100 = fully closed. The IR
// commands only go all the way, so below 50% opens, the rest closes.
template <size_t I> static void zbLift(uint8_t pct) { zbEnqueue(I, pct < 50 ? 0 : 2); }

struct ZbCallbacks {
  void (*open)();
  void (*stop)();
  void (*close)();
  void (*lift)(uint8_t);
};
template <size_t... I>
static const ZbCallbacks* zbCallbackTable(std::index_sequence<I...>) {
  static const ZbCallbacks table[] = {{&zbOpen<I>, &zbStop<I>, &zbClose<I>, &zbLift<I>}...};
  return table;
}

static String zbCoverName(uint8_t cover) {
  const uint8_t p = cover / 4, m = cover % 4;
  return String(m == 3 ? kPanels[p].all : kPanels[p].motor[m]);
}

// What Home Assistant was last told for each cover, so only changes are sent.
static uint8_t zbReported[kZbMaxCovers];

// The estimated position (see "position estimate") to report: whole
// percent, never exactly 0 or 100 - at the ends HA greys out the open (close)
// button, and opening or closing again must always be possible.
static uint8_t zbReportPct(float v) {
  int r = (int)(v + 0.5f);
  if (r < kZigbeePosMinPct) r = kZigbeePosMinPct;
  if (r > kZigbeePosMaxPct) r = kZigbeePosMaxPct;
  return (uint8_t)r;
}

static void zbReportCover(int cover, uint8_t v) {
  if (!zbCovers[cover] || zbReported[cover] == v) return;
  zbCovers[cover]->setLiftPercentage(v);
  zbReported[cover] = v;
}

// Sends the estimated positions to the coordinator, at most once per
// kZigbeePositionReportMs, and only what changed: while a motor runs that is
// every second, otherwise nothing. The "all" cover shows the three motors'
// average.
static void handlePositions(bool force = false) {
  if (!zbStarted) return;
  static uint32_t last = 0;
  const uint32_t now = millis();
  if (!force && (uint32_t)(now - last) < kZigbeePositionReportMs) return;
  last = now;
  float pct[kPanelCount][3];
  portENTER_CRITICAL(&posMux);
  for (int p = 0; p < kPanelCount; ++p)
    for (int i = 0; i < 3; ++i) {
      posAdvance(p, i, now);
      pct[p][i] = motorPos[p][i].pct;
    }
  portEXIT_CRITICAL(&posMux);
  for (int p = 0; p < kPanelCount; ++p) {
    for (int i = 0; i < 3; ++i) zbReportCover(p * 4 + i, zbReportPct(pct[p][i]));
    zbReportCover(p * 4 + 3, zbReportPct((pct[p][0] + pct[p][1] + pct[p][2]) / 3.0f));
  }
}

static void runZigbeeCommand(const ZbCommand& c) {
  static const char* const kNames[3] = {"open", "stop", "close"};
  const int p = c.cover / 4, m = c.cover % 4;
  pushLog(String("ZB  Zigbee  ") + zbCoverName(c.cover) + ": " + kNames[c.action]);
  const char* err = runCommand(p, m, c.action, nullptr);
  if (c.action == 1) stopPendingCover = -1;   // the STOP has gone out
  if (err) {
    pushLog(String("!!  Zigbee command: ") + err);
    return;
  }
  Serial.printf("[%lu ms] Zigbee: IR sent\n", (unsigned long)millis());
}

// The task that sends the Zigbee commands: it sleeps on the queue and acts
// the moment one arrives, at a priority above loop() (web server, battery,
// LED...) - a slow HTTP request never holds a command up. See
// kCmdTaskPriority in Config.h.
static void zbCmdTask(void*) {
  for (;;) {
    ZbCommand c;
    if (xQueueReceive(zbQueue, &c, portMAX_DELAY) == pdTRUE) runZigbeeCommand(c);
  }
}

// The Zigbee stack only runs once the board has been paired. "Paired" is
// remembered in NVS (set when the network is joined); until then the stack
// stays off - no radio activity at all - and the web UI's "Start pairing"
// button starts it, as a device that looks for a network to join.
static bool zbPairedFlag() {
  prefs.begin("velux", true);
  const bool v = prefs.getUChar("zbpair", 0) != 0;
  prefs.end();
  return v;
}

static void setZbPaired(bool v) {
  prefs.begin("velux", false);
  prefs.putUChar("zbpair", v ? 1 : 0);
  prefs.end();
}

static volatile bool zbStartRequested  = false;   // set by the web UI, acted on in loop()
static volatile bool zbForgetRequested = false;

static bool zbRequestPair() {
  if (zbStarted && Zigbee.connected()) return false;
  zbStartRequested = true;
  return true;
}

static void zbRequestForget() { zbForgetRequested = true; }

// erase: start from a clean slate (unpaired board: whatever the chip still
// remembers of an old network must not make it try to rejoin instead of pair).
static void setupZigbee(bool erase) {
  zbQueue = xQueueCreate(8, sizeof(ZbCommand));
  xTaskCreate(zbCmdTask, "zb_cmd", 4096, nullptr, kCmdTaskPriority, nullptr);
  const ZbCallbacks* cb = zbCallbackTable(std::make_index_sequence<kZbMaxCovers>{});

  for (uint8_t i = 0; i < kZbCovers; ++i) {
    ZigbeeWindowCovering* cv = new ZigbeeWindowCovering(kZigbeeFirstEndpoint + i);
    cv->setManufacturerAndModel(kZigbeeManufacturer, kZigbeeModel);
    // The covering type shows in ZHA's diagnostics (both map to the "shade"
    // device class): blinds are exterior roller shades, windows plain roller
    // shades - Zigbee has no window type. SHUTTER is not used: ZHA treats it
    // as tilt-only and drops up/down.
    cv->setCoveringType(kPanels[i / 4].kind == kCoverBlind ? ROLLERSHADE_EXTERIOR : ROLLERSHADE);
    // operational, online, not reversed, no position sensing of any kind
    cv->setConfigStatus(true, true, false, false, false, false, false);
    cv->setMode(false, false, false, false);
    cv->setLimits(0, 100, 0, 0);
    cv->onOpen(cb[i].open);
    cv->onStop(cb[i].stop);
    cv->onClose(cb[i].close);
    cv->onGoToLiftPercentage(cb[i].lift);
    cv->onIdentify(zbIdentify);
    zbCovers[i] = cv;
    Zigbee.addEndpoint(cv);
    Serial.printf("Zigbee endpoint %u: %s\n", kZigbeeFirstEndpoint + i, zbCoverName(i).c_str());
  }
  if (batteryMv > 0)
    zbCovers[0]->setPowerSource(ZB_POWER_SOURCE_BATTERY, batteryPercent(batteryMv), (uint8_t)(batteryMv / 100));

  // Sleepy end device: the radio stays off between polls of the parent.
  Zigbee.setRxOnWhenIdle(!kZigbeeSleepy);
  esp_zb_cfg_t cfg = ZIGBEE_DEFAULT_ED_CONFIG();
  // (keep_alive is the parent's idea of how often we check in, not the poll
  // rate - that is set with zb_zdo_pim_set_long_poll_interval() after joining.)
  cfg.nwk_cfg.zed_cfg.keep_alive = kZigbeePollMs;
  zbTouch();
  // begin() waits for the stack to report in, up to this long, and returns
  // false if it hasn't - e.g. when the network it belonged to isn't there.
  // The stack keeps (re)joining in the background either way, so only a
  // stack that didn't initialise counts as failed.
  Zigbee.setTimeout(kZigbeeBeginWaitMs);
  Zigbee.begin(&cfg, erase);
  zbStarted = Zigbee.initialized();
  // The stack's own task above the web server's (lwIP) and the main loop.
  if (zbStarted) {
    const TaskHandle_t zbTask = xTaskGetHandle("Zigbee_main");
    if (zbTask) vTaskPrioritySet(zbTask, kZigbeeTaskPriority);
  }
  // The library only tells the network that the node sleeps (node
  // descriptor); the stack itself must be told too, or a rejoin after a
  // reboot waits for a reply the parent holds back until it is polled.
  if (zbStarted && kZigbeeSleepy && esp_zb_lock_acquire(pdMS_TO_TICKS(500))) {
    esp_zb_set_rx_on_when_idle(false);
    esp_zb_lock_release();
  }
  // Tell the network where the covers are right away (the estimate; halfway
  // at boot, since the position is unknown until a full run).
  if (zbStarted) {
    for (uint8_t i = 0; i < kZbMaxCovers; ++i) zbReported[i] = 0xFF;
    handlePositions(true);
  }
  Serial.printf("Zigbee: %s\n", !zbStarted           ? "FAILED to start"
                               : Zigbee.connected() ? "started, joined"
                                                    : "started, looking for a network");
}

// The stack resets the long poll interval to its default (~5 s, which is the
// delay every command used to have) whenever the node joins or rejoins, so
// it has to be set again after that - zb_zdo_pim_set_long_poll_interval() -
// and every now and then, to be safe. Turbo poll is the stack's own fast
// polling for a while after activity.
static uint32_t zbPollMs = 0;   // the long poll interval the stack was last given (0 = not yet)

static void zbApplyLongPoll() {
  if (!esp_zb_lock_acquire(pdMS_TO_TICKS(200))) return;   // try again on the next pass
  zb_zdo_pim_set_long_poll_interval(kZigbeePollMs);
  esp_zb_lock_release();
  zbPollMs = kZigbeePollMs;
}

static void zbStartTurboPoll() {
  if (!esp_zb_lock_acquire(pdMS_TO_TICKS(200))) return;
  zb_zdo_pim_start_turbo_poll_continuous(kZigbeeFastPollHoldMs);
  esp_zb_lock_release();
}

static void handleZigbeePoll() {
  if (!zbStarted) return;
  static bool wasConnected = false;
  static uint32_t lastApply = 0, turboFor = 0;
  const bool connected = Zigbee.connected();
  const uint32_t now = millis();
  if (connected && !wasConnected) {
    zbTouch();                                  // just joined: Home Assistant is about to talk
    if (!zbPairedFlag()) setZbPaired(true);     // from now on the stack starts at boot
    lastApply = 0;
  }
  wasConnected = connected;
  if (!connected) return;
  // The join procedure finishes after the "joined" signal: apply the poll
  // interval right away, again a few seconds later, then every 30 s.
  if (!lastApply || (uint32_t)(now - lastApply) >= (zbPollMs == kZigbeePollMs && lastApply ? 30000u : 3000u)) {
    zbApplyLongPoll();
    lastApply = now ? now : 1;
  }
  if (zbActiveAt && zbActiveAt != turboFor) {   // new activity: poll fast for a while
    turboFor = zbActiveAt;
    zbStartTurboPoll();
  }
}

// Battery % (and voltage) to the coordinator: right after joining, then
// every kZigbeeBatteryReportMs.
static void handleZigbeeBattery() {
  static uint32_t last = 0;
  if (!zbStarted || !Zigbee.connected() || batteryMv < 0) return;
  const uint32_t now = millis();
  if (last && (uint32_t)(now - last) < kZigbeeBatteryReportMs) return;
  last = now ? now : 1;
  zbCovers[0]->setBatteryPercentage(batteryPercent(batteryMv));
  zbCovers[0]->setBatteryVoltage((uint8_t)(batteryMv / 100));
  zbCovers[0]->reportBatteryPercentage();
}

// Leaves the network and goes back to "not paired" (the stack is off again
// after the restart; pairing is started from the web UI).
static void zbForgetNetwork() {
  setZbPaired(false);
  if (zbStarted) Zigbee.factoryReset();   // erases the network settings and restarts
  else           pushLog("--  Zigbee: not paired");
}

// Requests from the web UI, acted on here and not in its HTTP handlers: the
// stack takes a moment to start.
static void handleZigbeeRequests() {
  if (zbForgetRequested) {
    zbForgetRequested = false;
    pushLog("--  Zigbee: forgetting the network");
    zbForgetNetwork();
  }
  if (zbStartRequested) {
    zbStartRequested = false;
    if (!zbStarted) {
      pushLog("--  Zigbee: pairing started - put the coordinator in permit join");
      setupZigbee(!zbPairedFlag());
    }
  }
}

// BOOT held for 3s: leave the Zigbee network (pair again from the web UI).
static void handleZigbeeReset() {
  if (!zbStarted) return;
  static uint32_t pressedSince = 0;
  if (digitalRead(kZigbeeResetPin) != LOW) { pressedSince = 0; return; }
  const uint32_t now = millis();
  if (!pressedSince) { pressedSince = now ? now : 1; return; }
  if ((uint32_t)(now - pressedSince) < 3000) return;
  pushLog("--  BOOT held 3s: leaving the Zigbee network");
  for (uint8_t i = 0; i < 6; ++i) { digitalWrite(kStatusLedPin, i & 1 ? LOW : HIGH); delay(150); }
  zbForgetNetwork();
}

static const char* zigbeeStatus() {
  if (zbStarted) return Zigbee.connected() ? "joined" : "pairing: looking for a network";
  if (zbStartRequested) return "starting";
  return zbPairedFlag() ? "failed to start" : "not paired (press Start pairing in the web UI)";
}

static bool zigbeePairing() {
  return zbStarted && !Zigbee.connected();
}

// Status LED: steady while booting, one short flash every kLedPairingPeriodMs
// while the Zigbee stack looks for a network (pairing, or rejoining), one
// every kLedIdlePeriodMs once joined and waiting - or not paired, stack off.
// The same with Wi-Fi on or off. Home Assistant's "Identify" overrides all of
// it: a pulse every kLedIdentifyPeriodMs for kLedIdentifyMs.
// loop() sleeps no longer than ledWaitMs(), so a flash ends on time.
static bool statusLedBooted = false;   // set at the end of setup()
static bool ledLit = false;
static uint32_t ledSince = 0;

static bool ledIdentifying() {
  const uint32_t until = ledIdentifyUntil;
  return until && (int32_t)(until - millis()) > 0;
}

static uint32_t ledPeriodMs() {   // 0 = steady on
  if (ledIdentifying()) return kLedIdentifyPeriodMs;
  if (!statusLedBooted) return 0;
  if (zigbeePairing()) return kLedPairingPeriodMs;
  return kLedIdlePeriodMs;
}

static uint32_t ledFlashMs() {
  return ledIdentifying() ? kLedIdentifyFlashMs : kLedFlashMs;
}

static void handleStatusLed() {
  const uint32_t period = ledPeriodMs();
  const uint32_t flash = ledFlashMs();
  const uint32_t el = millis() - ledSince;
  const bool want = !period ? true
                  : ledLit  ? el < flash
                            : el >= period - flash;
  if (want == ledLit) return;
  ledLit = want;
  ledSince = millis();
  digitalWrite(kStatusLedPin, ledLit ? HIGH : LOW);
}

// Milliseconds until the LED next needs to change.
static uint32_t ledWaitMs() {
  const uint32_t period = ledPeriodMs();
  if (!period) return kLoopMaxWaitMs;
  const uint32_t flash = ledFlashMs();
  const uint32_t el = millis() - ledSince;
  const uint32_t target = ledLit ? flash : period - flash;
  return el >= target ? 1 : target - el;
}

// USB log: a line whenever the mode switch or the BOOT button changes level
// (handy to check the wiring), and one status line every kUsbLogStatusMs.
static void handleSerialDebug() {
  if (!usbLog) return;
  static int lastSw = -1, lastBoot = -1;
  const int sw = digitalRead(kWifiSwitchPin), boot = digitalRead(kZigbeeResetPin);
  if (sw != lastSw || boot != lastBoot) {
    Serial.printf("Pins: switch GPIO%u = %d, BOOT GPIO%u = %d\n", kWifiSwitchPin, sw, kZigbeeResetPin, boot);
    lastSw = sw;
    lastBoot = boot;
  }
  static uint32_t last = 0;
  const uint32_t now = millis();
  if (last && (uint32_t)(now - last) < kUsbLogStatusMs) return;
  last = now ? now : 1;
  String net = "Zigbee only";
  if (wifiEnabled) net = staConnected ? "Wi-Fi " + WiFi.localIP().toString()
                                      : String(apActive ? "Wi-Fi setup AP" : "Wi-Fi not connected");
  Serial.printf("[%s, up %s] %s | Zigbee: %s, poll %u ms | battery %d mV | heap %u\n",
                clockStamp().c_str(), formatUptime(now / 1000).c_str(), net.c_str(), zigbeeStatus(),
                (unsigned)zbPollMs, (int)batteryMv, (unsigned)ESP.getFreeHeap());
}

void setup() {
  for (uint8_t p = 0; p < kPanelCount; ++p)       // position unknown until a full run
    for (uint8_t i = 0; i < 3; ++i) motorPos[p][i] = {(float)kZigbeeStartLiftPct, 0, 0};
  cmdLock  = xSemaphoreCreateRecursiveMutex();
  logLock  = xSemaphoreCreateMutex();
  loopTask = xTaskGetCurrentTaskHandle();

  // Boot runs at full speed (kCpuFreqBootMhz): Wi-Fi, Zigbee and the web
  // server start faster. Once setup() is done the clock policy of the mode
  // takes over (end of this function). The mode switch is read first.
  setCpuFrequencyMhz(kCpuFreqBootMhz);
  pinMode(kWifiSwitchPin, INPUT_PULLDOWN);   // unplugged switch = OFF
  delayMicroseconds(300);                    // let the pull-down settle
  wifiEnabled = readWifiSwitch();

  setenv("TZ", kTimezone, 1);   // local time in logs, also without Wi-Fi
  tzset();
  restoreClock();               // the time stored at the last restart / hourly

  // The USB log is a stored setting (web UI, Settings), on unless switched off.
  prefs.begin("velux", true);
  usbLog = prefs.getUChar("usblog", kUsbLogDefault ? 1 : 0) != 0;
  prefs.end();
  if (usbLog) {
    Serial.begin(115200);
    // give the serial monitor time to (re)open the port
    for (const uint32_t t0 = millis(); !Serial && millis() - t0 < kUsbLogWaitMs;) delay(10);
    delay(200);
  } else {
    // Nothing printed, and the USB port left alone so light sleep can switch it off.
    esp_log_level_set("*", ESP_LOG_NONE);
    Serial.end();
  }
  Serial.printf("\nVELUX WLI 130 51 - IR bridge  [v %s]\n", kVersion);
  Serial.printf("Reset reason: %s\n", resetReasonName(esp_reset_reason()));
  for (uint8_t i = 0; i < kPanelCount; ++i)
    for (uint8_t j = 0; j < 4; ++j) lastDirAction[i][j] = -1;

  irIdle();   // IR LED off

  analogSetPinAttenuation(kBatteryPin, ADC_11db);   // widest range
  sampleBattery();                                  // so the first /api/status has it
  logBattery(true);                                 // starting point of the 2h log

  for (uint8_t i = 0; i < kPanelCount; ++i) {
    panelCode[i] = parseSecurity(kPanels[i].security);
    Serial.printf("Panel %u: %-12s security %s%s\n", i, kPanels[i].name,
                  kPanels[i].security,
                  panelCode[i] == 0xFFFF ? "  <-- INVALID (need 10 digits 0/1)" : "");
  }

  pinMode(kStatusLedPin, OUTPUT);
  digitalWrite(kStatusLedPin, HIGH);   // steady while booting (statusLedBooted)
  ledLit = true;
  pinMode(kZigbeeResetPin, INPUT_PULLUP);
  Serial.printf("Mode: %s\n", wifiEnabled ? "Wi-Fi ON (web UI, HTTP API, OTA)" : "Zigbee only, Wi-Fi off");

  if (wifiEnabled) {
    setupWifi();
    setupHttp();
    // UTC only (the browser shows local time). SNTP keeps retrying in the
    // background until the board has internet, then re-syncs about hourly.
    if (kNtpServer[0]) {
      sntp_set_time_sync_notification_cb([](struct timeval*) {
        clockFromNtp = true;
        clockSaveDue = true;   // store it: Zigbee-only mode has no internet
      });
      configTzTime(kTimezone, kNtpServer);
    }

    ArduinoOTA.setHostname(kHostname);
    ArduinoOTA.setPort(kOtaPort);
    ArduinoOTA.onStart([] { holdAwakeForUpdate(true); });
    ArduinoOTA.onError([](ota_error_t) { holdAwakeForUpdate(false); });
    ArduinoOTA.begin();

    // Only now do both sockets exist - see waitForWork().
    httpListenFd = findSocket(SOCK_STREAM, kHttpPort);
    otaFd        = findSocket(SOCK_DGRAM, kOtaPort);
    Serial.printf("Idle wait on sockets: http %d, OTA %d%s\n", httpListenFd, otaFd,
                  httpListenFd < 0 ? "  <-- not found, falling back to a timed pause" : "");
  }

  // The Zigbee stack starts here only on a board that has been paired; on a
  // new one it waits for "Start pairing" in the web UI (Wi-Fi mode).
  if (zbPairedFlag()) setupZigbee(false);
  else                Serial.println("Zigbee: not paired - use Start pairing in the web UI (Wi-Fi switch ON)");

  // Boot is over: the clock policy of the mode. With power management the
  // clock now floats (Zigbee only) or stays at the maximum (Wi-Fi); without
  // it (USB log on, or no PM in the build) it is set once.
  setupPowerManagement();
  if (!pmBusyLock) setCpuFrequencyMhz(wifiEnabled ? kCpuFreqWifiMhz : kCpuFreqMhz);
  Serial.printf("Power management: %s\n", pmStatus.c_str());
  Serial.printf("CPU frequency: %u MHz (boot at %u MHz)\n", getCpuFrequencyMhz(), (unsigned)kCpuFreqBootMhz);

  statusLedBooted = true;   // from now on the LED shows the Zigbee state
  handleStatusLed();
}

// Blocks until one of the sockets has something to read (see "idle wait"
// near the top), or waitMs passes.
static void waitForWork(uint32_t waitMs) {
  if (httpListenFd < 0) {    // couldn't find the sockets: pause, don't spin
    delay(waitMs < 100 ? waitMs : 100);
    return;
  }
  fd_set rd;
  FD_ZERO(&rd);
  int maxFd = -1;
  const int fds[3] = {httpListenFd, otaFd, server.client().fd()};
  for (int fd : fds) {
    if (fd < 0) continue;
    FD_SET(fd, &rd);
    if (fd > maxFd) maxFd = fd;
  }
  timeval tv;
  tv.tv_sec  = waitMs / 1000;
  tv.tv_usec = (waitMs % 1000) * 1000;
  select(maxFd + 1, &rd, nullptr, nullptr, &tv);
}

void loop() {
  if (wifiEnabled) {
    server.handleClient();
    ArduinoOTA.handle();
    handleWifiWatchdog();
  }
  handleBattery();
  handleClockSave();
  irTestTimeout();
  handleModeSwitch();
  handleZigbeeRequests();
  handleZigbeeReset();
  handleZigbeeBattery();
  handleZigbeePoll();
  handlePositions();
  handleStatusLed();
  handleSerialDebug();
  if (pmUpdateHold) return;

  // Where the loop sleeps until there is something to do.
  if (wifiEnabled) {
    waitForWork(100);      // the web server's sockets (Zigbee commands have their own task)
  } else {
    // Zigbee only: sleep until the LED needs attention (or Identify wakes us)
    const uint32_t wait = ledWaitMs();
    ulTaskNotifyTake(pdTRUE, pdMS_TO_TICKS(wait < kLoopMaxWaitMs ? wait : kLoopMaxWaitMs));
  }
}
